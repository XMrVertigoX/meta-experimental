## conf/distro/poky-hubris.conf
```bitbake
require conf/distro/poky.conf

DISTRO = "poky-hubris"

DISTRO_FEATURES_append = " \
	systemd \
	"

DISTRO_FEATURES_remove = " \
	3g \
	alsa \
	bluetooth \
	irda \
	nfc \
	opengl \
	pci \
	pcmcia \
	vulkan \
	wayland \
	wifi  \
	x11 \
	"

VIRTUAL-RUNTIME_init_manager = "systemd"
```

## conf/layer.conf
```bitbake
BBPATH .= ":${LAYERDIR}"

BBFILES .= " \
	${LAYERDIR}/recipes-*/*/*.bb \
	${LAYERDIR}/recipes-*/*/*.bbappend \
	"

BBFILE_COLLECTIONS += "hubris-layer"
BBFILE_PATTERN_hubris-layer = "^${LAYERDIR}/"
BBFILE_PRIORITY_hubris-layer = "6"

LAYERSERIES_COMPAT_hubris-layer = "zeus"
LAYERVERSION_hubris-layer = "1"
LAYERDEPENDS_hubris-layer = " \
	freescale-layer \
	networking-layer \
	"
```

## conf/local.conf.sample
```bitbake
CONF_VERSION = "1"

DL_DIR = "/var/tmp/yocto/downloads"
SSTATE_DIR = "/var/tmp/yocto/sstate-cache"

DISTRO = "poky-hubris"
MACHINE = "phyboard-mira-imx6-hubris"

ACCEPT_FSL_EULA = "1"
```

## conf/machine/phyboard-mira-imx6-hubris.conf
```bitbake
MACHINEOVERRIDES =. "mx6:mx6q:"

require conf/machine/include/imx-base.inc
require conf/machine/include/tune-cortexa9.inc

SERIAL_CONSOLES = "115200;ttyS0 115200;ttyGS0"

# #############################################################################
# Kernel

PREFERRED_PROVIDER_virtual/kernel = "linux-hubris"
# PREFERRED_VERSION_linux-hubris = "4.19"
INTREE_DEFCONFIG = "phyboard-mira-imx6-hubris_defconfig"
KERNEL_DEVICETREE = "phyboard-mira-imx6-hubris.dtb"

# #############################################################################
# Bootloader

PREFERRED_PROVIDER_virtual/bootloader = "u-boot-hubris"
# PREFERRED_VERSION_u-boot-hubris = "v2019.07"
UBOOT_MACHINE = "pcm058_defconfig"
UBOOT_MAKE_TARGET = "all"
UBOOT_SUFFIX = "img"
SPL_BINARY = "SPL"
```
